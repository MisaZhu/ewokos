## kernel/arch/arm/Kconfig
```kconfig
#
# For a description of the syntax of this configuration file,
# see Documentation/kbuild/kconfig-language.txt.
#

mainmenu "EwokOS - Micro-kernel OS Configuration"

config ARM
	bool
	default y
	help

menu "ARM system options"

choice
	prompt "ARM system type"
	default ARCH_VERSATILEPB

config ARCH_VERSATILEPB
	bool "ARM Versatile-PB"

config ARCH_RASPI2
	bool "Raspberry Pi 2"

endchoice

source arch/arm/common/Kconfig

menu "Compiler options"

config ARM_THUMB2
	bool "Compile the firmware in thumb mode"
	depends on CPU_32v7 || CPU_32v7M || CPU32_v6T2
	select ARM_EABI
	select ARM_ASM_UNIFIED
	help
	  By enabling this option, the kernel will be compiled in
	  thumb mode. A compiler/assembler that understand the unified
	  ARM-thumb syntax is needed.
	  If unsure, say N.

config ARM_ASM_UNIFIED
	bool

config ARM_EABI
	bool "Use the ARM EABI application binary interface"
	help
	  This option allows for the firmware to be compiled using the latest
	  ARM ABI (aka EABI).

endmenu

endmenu

source "arch/arm/mach-versatilepb/Kconfig"
source "arch/arm/mach-raspi2/Kconfig"

source "kernel/Kconfig"
source "drivers/Kconfig"
source "lib/Kconfig"
source "init/Kconfig"
```

## kernel/arch/arm/common/Kconfig
```kconfig
# Cortex-M3
config CPU_CORTEXM3
	bool
	select CPU_32v7M
	help

# Cortex-A9
config CPU_CORTEXA9
	bool
	select CPU_32v7
	help

# Figure out what processor architecture version we should be using.
# This defines the compiler instruction set which depends on the machine type.
config CPU_32v4
	bool
	help
	  Includes only the ARM instruction set.

config CPU_32v4T
	bool
	help
	  Adds the Thumb instruction set.

config CPU_32v5T
	bool
	help
	  Adds CLZ and BKPT.

config CPU_32v5TE
	bool
	help
	  Adds PLD, LDRD, STRD, MCRR, MRRC, enhances DSP algorithms.

config CPU_32v5TEJ
	bool
	help
	  Adds BXJ and Jazelle architecture extension.

config CPU_32v6
	bool
	help
	  Adds many new instructions to ARM instruction set and formalizes and
	  revises the memory model and the Debug architecture.

config CPU_32v6K
	bool
	help
	  Adds multi-processing instructions and extra memory model features.

config CPU_32v6T2
	select ARM_THUMB2
	bool
	help
	  Introduces Thumb-2 technology.

config CPU_32v6KZ
	bool
	help
	  ARMv6K with optional Security Extension.

config CPU_32v7
	bool

config CPU_32v7M
	bool
	select ARM_THUMB2

config CPU_BIG_ENDIAN
	bool "Build big-endian kernel"
	depends on ARCH_SUPPORTS_BIG_ENDIAN
	help
	  Say Y if you plan on running a kernel in big-endian mode.
	  Note that your board must be properly built and your board
	  port must properly enable any big-endian related features
	  of your chipset/board/processor.
```

## kernel/init/Kconfig
```kconfig
#
# For a description of the syntax of this configuration file,
# see scripts/kbuild/config-language.txt.
#

menu 'Generic setup'

config EXPERIMENTAL
	bool "Prompt for development"
	help
	  Some of the various things that SDFirm supports can be in a state
	  of development where the functionality, stability, or the level of
	  testing is not yet high enough for general use. This is usually
	  known as the "alpha-test" phase among developers. If a feature is
	  currently in alpha-test, then the developers usually discourage
	  uninformed widespread use of this feature by the general public to
	  avoid "Why doesn't this work?" type mail messages. However, active
	  testing and use of these systems is welcomed. Just be aware that it
	  may not meet the normal level of reliability or it may fail to work
	  in some special cases. Detailed bug reports from people familiar
	  with the kernel internals are usually welcomed by the developers
	  This option will also make obsoleted drivers available. These are
	  drivers that have been replaced by something else, and/or are
	  scheduled to be removed in a future kernel release.
	  Unless you intend to help test and develop a feature or driver that
	  falls into this category, or you have a situation that requires
	  using these features, you should probably say N here, which will
	  cause the configurator to present you with fewer choices. If
	  you say Y here, you will be offered the choice of using features or
	  drivers that are currently considered to be in the alpha-test phase.

config CC_OPT_SIZE
	bool "Optimize for size"
	default y
	help
	  Enabling this option will pass "-Os" instead of "-O2" to compiler
	  resulting in a smaller kernel.
	  If unsure, say N.

menuconfig DEBUG
	bool 'Debugging options'
	depends EXPERIMENTAL

if DEBUG

config CC_GEN_DEBUG
	bool "Compile with debug info"
	help
	  Say Y here if you wish to examine internals while applets are
	  running.  This increases the size of the binary considerably, and
	  should only be used when doing development.  If you are doing
	  development and want to debug, answer Y.
	  Most people should answer N.

config CC_GEN_EXTRA_WARNINGS
	bool "Compile with extra warnings"

endif

endmenu
```

## kernel/kernel/Kconfig
```kconfig
#
# Firmware Features
#

menu "Feature setup"

config KEYMAP2
	bool "Use keymap2"

endmenu
```
